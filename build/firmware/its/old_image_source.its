## build/firmware/its/old_image_source.its
```
/dts-v1/;
/ {
	description = "OPTEE and U-Boot";
	#address-cells = <0x1>;
	images {
		uboot {
			description = "U-Boot";
			data = /incbin/("./u-boot/u-boot.bin");
			type = "standalone";
			arch = "arm";
			compression = "none";
			load = <FIT_UBOOT_LOAD_ADDRESS>;
			hash-1 {
				algo = "sha256";
			};
		};
		optee {
			description = "OPTEE";
			data = /incbin/("./optee_os/core/tee-pager_v2.bin");
			type = "firmware";
			os = "tee";
			arch = "arm";
			compression = "none";
			load = <FIT_OPTEE_LOAD_ADDRESS>;
			entry = <FIT_OPTEE_ENTRY_POINT>;
			hash-1 {
				algo = "sha256";
			};
		};
	};
	configurations {
		default = "cfg-1";
		cfg-1 {
			description = "Windows IoT Core i.MX";
			firmware = "optee";
			loadables = "uboot";
			signature {
				algo = "sha256,rsa2048";
				key-name-hint = "dev";
				sign-images = "firmware","loadables";
			};
		};
	};
};
```

## build/firmware/its/uboot_optee_ecc_signed.its
```
/dts-v1/;
/ {
	description = "OPTEE and U-Boot";
	#address-cells = <0x1>;
	images {
		uboot {
			description = "U-Boot";
			data = /incbin/("./u-boot/u-boot-keyed.bin");
			type = "standalone";
			arch = "arm";
			compression = "none";
			load = <FIT_UBOOT_LOAD_ADDRESS>;
			hash-1 {
				algo = "sha256";
			};
		};
		optee {
			description = "OPTEE";
			data = /incbin/("./optee_os/core/tee-pager_v2.bin");
			type = "firmware";
			os = "tee";
			arch = "arm";
			compression = "none";
			load = <FIT_OPTEE_LOAD_ADDRESS>;
			entry = <FIT_OPTEE_ENTRY_POINT>;
			hash-1 {
				algo = "sha256";
			};
		};
	};
	configurations {
		default = "cfg-1";
		cfg-1 {
			description = "Windows IoT Core i.MX";
			firmware = "optee";
			loadables = "uboot";
			signature {
				algo = "sha256,ecc-prime256v1";
				key-name-hint = "ecc_prime256v1_dev_pem";
				sign-images = "firmware","loadables";
			};
		};
	};
};
```

## build/firmware/its/uefi_dtb_unsigned.its
```
/dts-v1/;

/ {
	description = "UEFI Firmware";

	images {
		uefi {
			description = "UEFI";
			data = /incbin/("./IMXBOARD_EFI.fd");
			type = "kernel";
			arch = "arm";
			os = "linux";
			compression = "none";
			load = <0x82004000>;
			entry = <0x82004000>;
			hash-1 {
				algo = "sha256";
			};
		};
		fdt-1 {
			description = "blank-dtb";
			data = /incbin/("../blank.dtb");
			type = "flat_dt";
			arch = "arm";
			compression = "none";
			hash-1 {
				algo = "sha256";
			};
		};
	};
	configurations {
		default = "conf-1";
		conf-1 {
			description = "UEFI Firmware";
			kernel = "uefi";
			fdt = "fdt-1";
		};
	};
};
```

## build/firmware/its/uefi_unsigned.its
```
/dts-v1/;

/ {
	description = "UEFI Firmware";

	images {
		uefi {
			description = "UEFI";
			data = /incbin/("./IMXBOARD_EFI.fd");
			type = "kernel";
			arch = "arm";
			os = "linux";
			compression = "none";
			load = <0x10820000>;
			entry = <0x10820000>;
			hash-1 {
				algo = "sha256";
			};
		};
	};
	configurations {
		default = "conf-1";
		conf-1 {
			description = "UEFI Firmware";
			kernel = "uefi";
		};
	};
};
```
